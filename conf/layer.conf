## conf/layer.conf
```bitbake
# We have a conf and classes directory, add to BBPATH
BBPATH .= ":${LAYERDIR}"

# We have recipes-* directories, add to BBFILES
BBFILES += "${LAYERDIR}/recipes-*/*/*.bb \
            ${LAYERDIR}/recipes-*/*/*.bbappend"

BBFILE_COLLECTIONS += "meta-rockchip-iotpi"
BBFILE_PATTERN_meta-rockchip-iotpi = "^${LAYERDIR}/"
BBFILE_PRIORITY_meta-rockchip-iotpi = "6"

LAYERDEPENDS_meta-rockchip-iotpi = "core"
LAYERSERIES_COMPAT_meta-rockchip-iotpi = "warrior"
```
